## boards/shields/split_ergo40pct/Kconfig.defconfig
```kconfig
if SHIELD_SPLIT_ERGO40PCT_LEFT

config ZMK_KEYBOARD_NAME
    default "split_ergo40pct"

endif

if SHIELD_SPLIT_ERGO40PCT_LEFT || SHIELD_SPLIT_ERGO40PCT_RIGHT

config ZMK_SPLIT
    default y

endif
```

## boards/shields/split_ergo40pct/Kconfig.shield
```kconfig
config SHIELD_SPLIT_ERGO40PCT_LEFT
    def_bool $(shields_list_contains,split_ergo40pct_left)
config SHIELD_SPLIT_ERGO40PCT_RIGHT
    def_bool $(shields_list_contains,split_ergo40pct_right)
```

## config/west.yml
```yaml
manifest:
  remotes:
    - name: zmkfirmware
      url-base: https://github.com/zmkfirmware
    - name: nuovotaka
      url-base: https://github.com/nuovotaka
  projects:
    - name: zmk
      remote: zmkfirmware
      revision: main
      import: app/west.yml
      import: app/prj.conf
    - name: zmk-driver-paw3222-alpha
      remote: nuovotaka
      revision: main
  self:
    path: config
```
